## components/espos_seatalk/Kconfig
```kconfig
# SPDX-FileCopyrightText: 2026 Marcel Verpaalen
# SPDX-License-Identifier: Apache-2.0

menu "SeaTalk 1 (espos_seatalk)"
    comment "Hardware pins and inversion are passed by the application in st_core_config_t."
endmenu
```

## components/espos_seatalk/examples/seatalk_to_sk/main/Kconfig.projbuild
```kconfig
# SPDX-FileCopyrightText: 2026 Marcel Verpaalen
# SPDX-License-Identifier: Apache-2.0

menu "SeaTalk example wiring"

    config EXAMPLE_SEATALK_RX_GPIO
        int "SeaTalk RX GPIO"
        default 13 if IDF_TARGET_ESP32S3
        default 32
        help
            GPIO connected to the SeaTalk RX interface. Avoid SPI flash and
            PSRAM pins (for example GPIO26-37 on ESP32-S3).

    config EXAMPLE_SEATALK_TX_GPIO
        int "SeaTalk TX GPIO"
        default 12 if IDF_TARGET_ESP32S3
        default 33
        help
            GPIO connected to the SeaTalk TX driver. Must be held LOW at boot
            so the SeaTalk bus stays released.

    config EXAMPLE_SEATALK_INVERT
        bool "Bus interface inverts RX and TX"
        default y
        help
            Enable for transistor/optocoupler interfaces that invert both lines.

endmenu
```

## components/espos_seatalk/examples/seatalk_to_sk/sdkconfig.defaults
```kconfig
# SPDX-FileCopyrightText: 2026 Marcel Verpaalen
# SPDX-License-Identifier: Apache-2.0
# Required espOS settings when building without espos_project_prologue().
CONFIG_ESP_SYSTEM_EVENT_TASK_STACK_SIZE=4096
CONFIG_FREERTOS_TIMER_TASK_STACK_DEPTH=4096
CONFIG_ESP_COREDUMP_ENABLE_TO_FLASH=y
CONFIG_WS_BUFFER_SIZE=2048
CONFIG_LWIP_MAX_SOCKETS=16
CONFIG_BOOTLOADER_APP_ROLLBACK_ENABLE=y
CONFIG_SECURE_SIGNED_APPS_NO_SECURE_BOOT=y
CONFIG_SECURE_SIGNED_ON_UPDATE_NO_SECURE_BOOT=y
CONFIG_SECURE_SIGNED_APPS_RSA_SCHEME=y
CONFIG_SECURE_BOOT_BUILD_SIGNED_BINARIES=y
CONFIG_ESP_HTTPS_OTA_ALLOW_HTTP=y
CONFIG_PARTITION_TABLE_CUSTOM=y
CONFIG_PARTITION_TABLE_CUSTOM_FILENAME="partitions.csv"
CONFIG_ESPTOOLPY_FLASHSIZE_4MB=y
CONFIG_ESPOS_SK_PENDING_MAX=16
CONFIG_ESPOS_CONFIG_MAX_SUBSCRIBERS=12
```

## components/espos_seatalk/examples/seatalk_to_sk/sdkconfig.defaults.esp32
```kconfig
# SPDX-FileCopyrightText: 2026 Marcel Verpaalen
# SPDX-License-Identifier: Apache-2.0
CONFIG_ESP32_REV_MIN_3=y
```

## main/Kconfig.projbuild
```kconfig
# SPDX-FileCopyrightText: 2026 Marcel Verpaalen
# SPDX-License-Identifier: Apache-2.0

menu "SeaTalk bridge"

    config ST_BRIDGE_UART_PORT
        int "UART for the SeaTalk bus"
        range 1 2
        default 1
        help
            Hardware UART used for the bus. UART0 is the console.

    config ST_BRIDGE_RX_GPIO
        int "Default SeaTalk RX GPIO"
        default 13 if IDF_TARGET_ESP32S3
        default 32
        help
            Default RX pin used when seatalk_hw.rx_pin is -1. 32 on the
            SeaTalk ESP32 Remote board (classic ESP32), 13 on the ESP32-S3
            SuperMini wiring. Overridable at runtime in the espOS web UI.

    config ST_BRIDGE_TX_GPIO
        int "Default SeaTalk TX GPIO"
        default 12 if IDF_TARGET_ESP32S3
        default 33
        help
            Default TX pin used when seatalk_hw.tx_pin is -1. HIGH pulls the
            bus low (jams it), so it is driven LOW first thing in app_main.
            33 on the SeaTalk ESP32 Remote board, 12 on the ESP32-S3 SuperMini
            wiring. Overridable at runtime in the espOS web UI.

    config ST_BRIDGE_LED_EN_GPIO
        int "Default GPIO that enables the RX/TX lights (-1 = none)"
        range -1 48
        default 11 if IDF_TARGET_ESP32S3
        default -1
        help
            Default output pin that switches the bus activity lights on and
            off when seatalk_hw.led_en_pin is -1. 11 on the ESP32-S3 SuperMini
            wiring; -1 when the board has no such pin. Overridable at runtime.

    config ST_BRIDGE_BENCH
        bool "Bench console on USB serial (key commands, statistics)"
        default n
        help
            Compile the bench console: single-key commands on the USB serial
            port (self-test, RX monitor, datagram table, statistics). Costs one
            4 KB task. Off by default for release builds; enable in
            sdkconfig.local for bench sessions.

    config ST_BRIDGE_TELNET
        bool "Telnet console (port 23, unauthenticated: bench use only)"
        default n
        depends on ST_BRIDGE_BENCH
        help
            Compile the telnet mirror of the bench console. It is compiled in
            only; at run time it is started and stopped by the espOS config
            setting seatalk_console.telnet (default off) and uses no RAM while off.
            The console has no authentication: anyone on the LAN can send keys.

    config ST_BRIDGE_SIM
        bool "Simulated boat (demo values to the bus, keys v/V)"
        default n
        depends on ST_BRIDGE_BENCH
        help
            Compile the simulated boat, which feeds demo values to the bus
            (keys v and V in the bench console).

endmenu
```
